## zephcore/boards/esp32/diy_esp32s3_n16r8_e22_back2back/Kconfig.diy_esp32s3_n16r8_e22_back2back
```kconfig
config BOARD_DIY_ESP32S3_N16R8_E22_BACK2BACK
	select SOC_ESP32S3_WROOM_N16
	select SOC_ESP32S3_PROCPU if BOARD_DIY_ESP32S3_N16R8_E22_BACK2BACK_ESP32S3_PROCPU
```

## zephcore/boards/esp32/diy_esp32s3_n16r8_e22_back2back/board.yml
```yaml
board:
  name: diy_esp32s3_n16r8_e22_back2back
  full_name: DIY ESP32-S3 N16R8 + E22-400M30S Back2Back
  vendor: diy
  socs:
    - name: esp32s3
```

## zephcore/boards/esp32/thinknode_m9/Kconfig.thinknode_m9
```kconfig
config BOARD_THINKNODE_M9
	select SOC_ESP32S3_WROOM_N16R8
	select SOC_ESP32S3_PROCPU if BOARD_THINKNODE_M9_ESP32S3_PROCPU
```

## zephcore/dts/bindings/input/zephcore,stc8h-keypad.yaml
```yaml
# Copyright 2026 ZephCore
# SPDX-License-Identifier: MIT

description: |
  STC8H companion-MCU keypad (I2C).

  A small helper MCU scans the key matrix and presents one register interface
  over I2C. Used by the Elecrow ThinkNode M9, whose keypad is its only input
  device — there is no user button on that board.

  Protocol:
    reg 0x01..0x04  battery millivolts, little-endian
    reg 0x05        code of the key currently pressed (0 = none)
    reg 0x06        state; writing 0x01 requests sleep

  The MCU raises its interrupt line (idle-low, rising edge) when a key is
  pressed. The driver reads register 0x05 on that edge and reports the result
  through Zephyr's input subsystem. If no interrupt GPIO is supplied the
  driver falls back to polling.

  Example:
    &i2c1 {
        keypad: keypad@6c {
            compatible = "zephcore,stc8h-keypad";
            reg = <0x6c>;
            irq-gpios = <&gpio0 12 GPIO_ACTIVE_HIGH>;
            poll-interval-ms = <40>;
        };
    };

compatible: "zephcore,stc8h-keypad"

include: [i2c-device.yaml]

properties:
  irq-gpios:
    type: phandle-array
    description: |
      Key-press interrupt from the helper MCU. Idle-low, rising edge on press.
      Optional — the driver polls when it is absent.

  poll-interval-ms:
    type: int
    default: 40
    description: |
      Poll period. Used as the sole scan mechanism when irq-gpios is absent,
      and as a safety net for a missed edge when it is present.
```

## zephcore/west.yml
```yaml
manifest:
  remotes:
    - name: zephyrproject-rtos
      url-base: https://github.com/zephyrproject-rtos

  projects:
    - name: zephyr
      remote: zephyrproject-rtos
      revision: 95c8eb4b1e6099bb6b8562f75d5fe4f282cf4a52
      import: true

  self:
    path: zephcore
```
