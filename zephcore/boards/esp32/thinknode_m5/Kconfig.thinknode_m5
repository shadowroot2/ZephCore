## zephcore/boards/esp32/thinknode_m5/Kconfig.thinknode_m5
```kconfig
config BOARD_THINKNODE_M5
	select SOC_ESP32S3_WROOM_N4
	select SOC_ESP32S3_PROCPU if BOARD_THINKNODE_M5_ESP32S3_PROCPU
```

## zephcore/boards/esp32/thinknode_m5/board.yml
```yaml
board:
  name: thinknode_m5
  full_name: Elecrow ThinkNode M5
  vendor: elecrow
  socs:
    - name: esp32s3
```
